## examples/myi2c/Kconfig
```kconfig
#
# For a description of the syntax of this configuration file,
# see the file kconfig-language.txt in the NuttX tools repository.
#

config EXAMPLES_MYI2C
	tristate "\"I2C test!\" example"
	default n
	---help---
		Enable the \"I2C test\" example

if EXAMPLES_MYI2C

config EXAMPLES_MYI2C_PROGNAME
	string "Program name"
	default "myi2c"
	---help---
		This is the name of the program that will be used when the NSH ELF
		program is installed.

config EXAMPLES_MYI2C_PRIORITY
	int "i2c task priority"
	default 100

config EXAMPLES_MYI2C_STACKSIZE
	int "i2c stack size"
	default DEFAULT_TASK_STACKSIZE

endif
```

## examples/myled/Kconfig
```kconfig
#
# For a description of the syntax of this configuration file,
# see the file kconfig-language.txt in the NuttX tools repository.
#

config EXAMPLES_MYLED
	tristate "\"Hello, World!\" example"
	default n
	---help---
		Enable the \"Hello, World!\" example

if EXAMPLES_MYLED

config EXAMPLES_MYLED_PROGNAME
	string "Program name"
	default "myled"
	---help---
		This is the name of the program that will be used when the NSH ELF
		program is installed.

config EXAMPLES_MYLED_PRIORITY
	int "Hello task priority"
	default 100

config EXAMPLES_MYLED_STACKSIZE
	int "Hello stack size"
	default DEFAULT_TASK_STACKSIZE

endif
```

## examples/mylvgl/Kconfig
```kconfig
#
# For a description of the syntax of this configuration file,
# see the file kconfig-language.txt in the NuttX tools repository.
#

menuconfig EXAMPLES_MY_LVGL
	tristate "my LVGL Demo"
	default n
	depends on GRAPHICS_LVGL && NETUTILS_CJSON
	---help---
		Enable build the Light and Versatile Graphics Library Demo programs

if EXAMPLES_MY_LVGL

config EXAMPLES_MY_LVGL_PRIORITY
	int "lvgldemo task priority"
	default 100

config EXAMPLES_MY_LVGL_STACKSIZE
	int "lvgldemo stack size"
	default 16384

config EXAMPLES_MY_LVGL_INPUT_DEVPATH
	string "Touchscreen device path"
	default "/dev/mytouch"
	depends on INPUT_TOUCHSCREEN
	---help---
		The path to the touchscreen device. Default: "/dev/mytouch"

endif # EXAMPLES_LVGLDEMO
```

## examples/mytouch/Kconfig
```kconfig
#
# For a description of the syntax of this configuration file,
# see the file kconfig-language.txt in the NuttX tools repository.
#

config EXAMPLES_MYTOUCH
	tristate "\"TOUCH test!\" example"
	default n
	---help---
		Enable the \"TOUCH test\" example

if EXAMPLES_MYTOUCH

config EXAMPLES_MYTOUCH_PROGNAME
	string "Program name"
	default "mytouch"
	---help---
		This is the name of the program that will be used when the NSH ELF
		program is installed.

config EXAMPLES_MYTOUCH_PRIORITY
	int "touch task priority"
	default 100

config EXAMPLES_MYTOUCH_STACKSIZE
	int "touch stack size"
	default DEFAULT_TASK_STACKSIZE

endif
```

## examples/test/Kconfig
```kconfig
#
# For a description of the syntax of this configuration file,
# see the file kconfig-language.txt in the NuttX tools repository.
#

config EXAMPLES_TEST
	tristate "\"TEST!\" example"
	default n
	---help---
		Enable the \"TEST!\" example

if EXAMPLES_TEST

config EXAMPLES_TEST_PROGNAME
	string "Program name"
	default "Test"
	---help---
		This is the name of the program that will be used when the NSH ELF
		program is installed.

config EXAMPLES_TEST_PRIORITY
	int "Test task priority"
	default 100

config EXAMPLES_TEST_STACKSIZE
	int "Test stack size"
	default DEFAULT_TASK_STACKSIZE

endif
```

## games/Snake/Kconfig
```kconfig
#
# For a description of the syntax of this configuration file,
# see the file kconfig-language.txt in the NuttX tools repository.
#

config GAMES_SNAKES
	tristate "GAMES_SNAKES"
	default n
	depends on NX
	select BOARDCTL
	---help---
		Enable the NX graphics example

if GAMES_SNAKES

config GAMES_SNAKES_DEFAULT_COLORS
	bool "Use Default Colors"
	default y

if !GAMES_SNAKES_DEFAULT_COLORS

config GAMES_SNAKES_BGCOLOR
	hex "Background Color"
	---help---
		The color of the background.  Default depends on config GAMES_SNAKES_BPP.

config GAMES_SNAKES_COLOR1
	hex "Color of Window 1"
	---help---
		The color of window 1. Default depends on config GAMES_SNAKES_BPP.

config GAMES_SNAKES_COLOR2
	hex "Color of Window 2"
	---help---
		The color of window 2. Default depends on config GAMES_SNAKES_BPP.

config GAMES_SNAKES_TBCOLOR
	hex "Toolbar Color"
	---help---
		The color of the toolbar. Default depends on config GAMES_SNAKES_BPP.

config GAMES_SNAKES_FONTCOLOR
	hex "Font Color"
	---help---
		The color of the fonts. Default depends on config GAMES_SNAKES_BPP.

endif

config GAMES_SNAKES_DEFAULT_FONT
	bool "Use Default Font"
	default y

config GAMES_SNAKES_FONTID
	int "Font ID"
	depends on !GAMES_SNAKES_DEFAULT_FONT
	---help---
		Selects the font (see font ID numbers in include/nuttx/nx/nxfonts.h)

config GAMES_SNAKES_BPP
	int "Bits-Per-Pixel"
	default 16
	---help---
		Pixels per pixel to use.  Valid options include 2, 4, 8, 16, 24,
		and 32.  Default is 16.

config GAMES_SNAKES_RAWWINDOWS
	bool "Use Raw Windows"
	default n
	---help---
		Use raw windows;  Default is to use pretty, framed NXTK windows with
		toolbars.

config GAMES_SNAKES_TOOLBAR_HEIGHT
	int "Tool bar height"
	default 16
	depends on !GAMES_SNAKES_RAWWINDOWS
	---help---
		The height of the toolbar in the NXTK framed windows

comment "NX Server Options"

config GAMES_SNAKES_STACKSIZE
	int "NX Server Stack Size"
	default DEFAULT_TASK_STACKSIZE
	---help---
		The stacksize to use when creating the NX server.  Default 2048

config GAMES_SNAKES_CLIENTPRIO
	int "Client Priority"
	default 100
	---help---
		The client priority.  Default: 100

config GAMES_SNAKES_SERVERPRIO
	int "Server Priority"
	default 120
	---help---
		The server priority.  Default: 120

config GAMES_SNAKES_LISTENERPRIO
	int "Listener Priority"
	default 80
	---help---
		The priority of the event listener thread. Default 80.

endif
```

## industry/upf/Kconfig
```kconfig
#
# For a description of the syntax of this configuration file,
# see the file kconfig-language.txt in the NuttX tools repository.
#

menuconfig INDUSTRY_UPF
	bool "Universal Protocol Framework (UPF)"
	default n
	---help---
		Enable support for the Universal Protocol Framework.

if INDUSTRY_UPF

config UPF_VERSION_MAJOR
	int "UPF_VERSION_MAJOR"
	default 1

config UPF_VERSION_MINOR
	int "UPF_VERSION_MINOR"
	default 2

config UPF_VERSION_PATCH
	int "UPF_VERSION_PATCH"
	default 3
		
config UPF_PROTOCOL_7E
	bool "UPF Protocol 7E"
	default n
	---help---
		Enable support for the UPF Protocol 7E.

config UPF_PROTOCOL_86
	bool "UPF Protocol 86"
	default n
	---help---
		Enable support for the UPF Protocol 86.

config UPF_PROTOCOL_MODBUS_RTU
	bool "UPF Protocol Modbus RTU"
	default n
	---help---
		Enable support for the UPF Protocol Modbus RTU.

config UPF_LOCK_ENABLE
	bool "Enable lock for RTOS"
	default n
	---help---
		Enable critical section lock macros for RTOS environments.
		Disable (default) for bare-metal, where LOCK/UNLOCK expand to nothing.

config UPF_DEMO
	bool "UPF Demo"
	default n
	---help---
		Enable demo programs for UPF, including User and ProtocolInstance modules.

if UPF_DEMO

config UPF_DEMO_ENABLE_7E
	bool "UPF Demo 7E"
	default n
	depends on UPF_PROTOCOL_7E
	---help---
		Enable 7E protocol demo.

config UPF_DEMO_ENABLE_86
	bool "UPF Demo 86"
	default n
	depends on UPF_PROTOCOL_86
	---help---
		Enable 86 protocol demo.

config UPF_DEMO_ENABLE_MODBUS_RTU
	bool "UPF Demo Modbus RTU"
	default n
	depends on UPF_PROTOCOL_MODBUS_RTU
	---help---
		Enable Modbus RTU protocol demo.

endif # UPF_DEMO


endif # INDUSTRY_UPF
```
